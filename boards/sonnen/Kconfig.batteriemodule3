## boards/sonnen/Kconfig.batteriemodule3
```kconfig
config BOARD_BATTERIEMODULE3
	select SOC_XMC4400
	select SOC_PART_NUMBER_F64X512
```

## boards/sonnen/batteriemodule3_defconfig
```kconfig
# SPDX-License-Identifier: Apache-2.0

CONFIG_ARM_MPU=y

# enable uart driver
CONFIG_SERIAL=y

# enable console
CONFIG_CONSOLE=y
CONFIG_UART_CONSOLE=y
CONFIG_USE_DT_CODE_PARTITION=y


# Enable CAN support
CONFIG_CAN=y
CONFIG_CAN_INIT_PRIORITY=80
```

## boards/sonnen/board.yml
```yaml
board:
  name: batteriemodule3
  full_name: BATTERIEMODULE3
  vendor: infineon
  socs:
  - name: xmc4400
```
